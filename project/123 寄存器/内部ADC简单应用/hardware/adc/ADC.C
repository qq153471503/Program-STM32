#include"adc.h"

void AdcInit(void)
{ 
	RCC -> APB2ENR |= 1<<2;			  //使能PA口时钟
	GPIOA -> CRL &= 0XFFFF0000;		  //设定PA0-PA3

	RCC -> APB2ENR |= 1<<9;			  //ADC时钟使能
	RCC -> APB2RSTR |= 1<<9;		  //ADC复位
	RCC -> APB2RSTR &= 0<<9;	//ADC复位结束

	RCC -> CFGR &= 0xc<<14;	 	//ADC预分频 清零 14 15位 用于设置
	RCC -> CFGR |= 2<<14;		 //设置为六分频	 72/6 = 12M

	ADC1 -> CR1 &= 0XF0FFFF;		//工作模式清零
	ADC1 -> CR1 |= 0<<16;			//设定独立工作模式
	ADC1 -> CR1 &= 0<<8;			//~(1<<8); 非扫描模式

	ADC1 -> CR2 &= 0<<1;			
	//~(1<<1); 该位[CONT]用于设置是否连续转换模式 本次用单词转换模式 写0

	ADC1 -> CR2 &= 0x0<<17;		  // ~(7<<17)
	ADC1 -> CR2 |= 7<<17;	
	// 此处17-19 这三位 用于启动规则转换组转换的外部事件 本次实验用的是软件触发  该三位为111

	ADC1 -> CR2 |= 1<<20;		//使用一个外部事件来触发  EXTTRIG位 20位  

/*注意此句 不可用(0<<11)的方式*/	
	ADC1 -> CR2 &= ~(1<<11);		//设置对其方式 本次实验右对齐 是0  ~(1<<11);
		
	ADC1 -> SQR1 &= 0x0<<20;		//复位一下	 ~(0xf<<20) 
	ADC1 -> SQR1 &= 0<<20;	
	//20-23位 用于设置规则通道有几个转换 0000 一个转换 1111 16个转换 ~(0XF<<20);	
	
	ADC1 -> SMPR2 &= 0XFFFF0000;
	  
//	ADC1 -> SMPR2 |= 7<<9;
//	ADC1 -> SMPR2 |= 7<<6;
//	ADC1 -> SMPR2 |= 7<<3;
	ADC1 -> SMPR2 |= 7<<0;		// 一个通道占三位 通道1  111  239.5周期 采样时间最长，用来提高采样精准率

	ADC1 -> CR2 |= 1<<0;		// ADON 第0位 打开AD转换器

	ADC1 -> CR2 |= 1<<3;		//RSTCAL 第三位 使能复位校准
	while(ADC1 ->CR2&1<<3);		//等待复位校准结束

	ADC1 -> CR2 |= 1<<2;		//CAL 第二位 打开AD校准
	while(ADC1 ->CR2&1<<2);		//等待AD校准结束
}

u16 AdcGet(u8 ch)
{
	ADC1 -> SQR3 &= 0XFFFFFFE0;		//规则序列中的第一个转换
	ADC1 -> SQR3 |= ch;
	ADC1 -> CR2 |= 1<<22;			//启动规则转换通道
	while(!(ADC1->SR&1<<1));		//等待转换结束

	return ADC1 -> DR ;			    //返回AD的值
}

